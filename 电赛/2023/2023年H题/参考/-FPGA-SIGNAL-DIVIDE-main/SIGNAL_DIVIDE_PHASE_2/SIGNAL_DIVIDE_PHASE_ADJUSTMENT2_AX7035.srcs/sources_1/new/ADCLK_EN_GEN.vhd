LIBRARY IEEE;
USE IEEE.STD_LOGIC_1164.ALL;
USE IEEE.STD_LOGIC_ARITH.ALL;
USE IEEE.STD_LOGIC_UNSIGNED.ALL;

ENTITY ADCLK_EN_GEN IS 
GENERIC(
  DIV:INTEGER:= 10
);
PORT(
  CLK:IN STD_LOGIC;
  RSTN:IN STD_LOGIC;
  CLK_EN:OUT STD_LOGIC
);
END ENTITY;

ARCHITECTURE BEHAVE OF ADCLK_EN_GEN IS 

SIGNAL CNT:INTEGER RANGE 0 TO DIV - 1:= 0;

BEGIN

  PROCESS IS BEGIN
  WAIT UNTIL RISING_EDGE(CLK);
    IF RSTN = '0' THEN
      CLK_EN <= '0';
    ELSE
      IF CNT >= DIV - 1 THEN
        CNT <= 0;
        CLK_EN <= '1';
      ELSE
        CLK_EN <= '0';
        CNT <= CNT + 1;
      END IF;
    END IF;
  END PROCESS;

END ARCHITECTURE;