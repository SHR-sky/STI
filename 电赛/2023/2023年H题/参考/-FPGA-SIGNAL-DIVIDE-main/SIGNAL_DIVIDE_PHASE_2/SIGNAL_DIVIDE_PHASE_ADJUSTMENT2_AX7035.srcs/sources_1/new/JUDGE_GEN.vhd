LIBRARY IEEE;
USE IEEE.STD_LOGIC_1164.ALL;
USE IEEE.STD_LOGIC_ARITH.ALL;
USE IEEE.STD_LOGIC_SIGNED.ALL;

ENTITY JUDGE_GEN IS 
GENERIC(
  VALUE_LIMIT:INTEGER:= 1000
);
PORT(
  ACLK:IN STD_LOGIC;
  ARESETN:IN STD_LOGIC;
  
  FFT_M_DATA_TVALID:IN STD_LOGIC;
  FFT_M_DATA_TDATA:IN STD_LOGIC_VECTOR(47 DOWNTO 0);
  FFT_M_DATA_TUSER:IN STD_LOGIC_VECTOR(15 DOWNTO 0);
  
  RE_0:OUT STD_LOGIC_VECTOR(11 DOWNTO 0);
  IM_0:OUT STD_LOGIC_VECTOR(11 DOWNTO 0);
  
  RE_1:OUT STD_LOGIC_VECTOR(11 DOWNTO 0);
  IM_1:OUT STD_LOGIC_VECTOR(11 DOWNTO 0);
  
  AF_OUT:OUT STD_LOGIC_VECTOR(7 DOWNTO 0);
  BF_OUT:OUT STD_LOGIC_VECTOR(7 DOWNTO 0);
  
  JUDGE_FINISH:OUT STD_LOGIC
);
END ENTITY;

ARCHITECTURE BEHAVE OF JUDGE_GEN IS 

SIGNAL FFT_M_DATA_TVALID_T:STD_LOGIC:= '0';
SIGNAL FFT_M_DATA_TDATA_T:STD_LOGIC_VECTOR(47 DOWNTO 0):= (OTHERS => '0');
SIGNAL FFT_M_DATA_TUSER_T:STD_LOGIC_VECTOR(15 DOWNTO 0):= (OTHERS => '0');

TYPE STATES IS (S_IDLE,S_READ,S_JUDGE1,S_JUDGE2,S_D0_GEN,S_D1_GEN,S_FINISH);
SIGNAL STATE:STATES:= S_IDLE;

SIGNAL MAX1_VALUE:INTEGER:= 0;
SIGNAL MAX2_VALUE:INTEGER:= 0;
SIGNAL MAX1_FRE:INTEGER RANGE 0 TO 1023:= 0;
SIGNAL MAX2_FRE:INTEGER RANGE 0 TO 1023:= 0;

TYPE INT_RAMS IS ARRAY(0 TO 1023) OF INTEGER RANGE 0 TO 8191;
SIGNAL JUDGE_RAM:INT_RAMS:= (OTHERS => 0);

TYPE RAMS IS ARRAY(0 TO 1023) OF STD_LOGIC_VECTOR(47 DOWNTO 0);
--SIGNAL FFT_RAM:RAMS:= (OTHERS => (OTHERS => '0'));
SIGNAL RAM0:RAMS:= (OTHERS => (OTHERS => '0'));
--SIGNAL RAM1:RAMS:= (OTHERS => (OTHERS => '0'));
ATTRIBUTE RAM_STYLE:STRING;
--ATTRIBUTE RAM_STYLE OF FFT_RAM:SIGNAL IS "BLOCK";
ATTRIBUTE RAM_STYLE OF RAM0:SIGNAL IS "BLOCK";
--ATTRIBUTE RAM_STYLE OF RAM1:SIGNAL IS "BLOCK";

SIGNAL JUDGE_CNT:INTEGER RANGE 0 TO 511:= 0;

SIGNAL WRITE_CNT:INTEGER RANGE 0 TO 1023:= 0;

SIGNAL AF_R:INTEGER RANGE 0 TO 511:= 0;
SIGNAL BF_R:INTEGER RANGE 0 TO 511:= 0;

SIGNAL DATA_0:STD_LOGIC_VECTOR(47 DOWNTO 0):= (OTHERS => '0');
SIGNAL DATA_1:STD_LOGIC_VECTOR(47 DOWNTO 0):= (OTHERS => '0');

FUNCTION ABS_GEN (A:INTEGER) RETURN INTEGER IS 
BEGIN
  IF A >= 0 THEN
    RETURN A;
  ELSE
    RETURN - A;
  END IF;
END FUNCTION;

BEGIN
  
  PROCESS IS BEGIN
  WAIT UNTIL RISING_EDGE(ACLK);
    FFT_M_DATA_TVALID_T <= FFT_M_DATA_TVALID;
    FFT_M_DATA_TDATA_T <= FFT_M_DATA_TDATA;
    FFT_M_DATA_TUSER_T <= FFT_M_DATA_TUSER;
  END PROCESS;
  
  PROCESS IS BEGIN
  WAIT UNTIL RISING_EDGE(ACLK);
    IF ARESETN = '0' THEN
      MAX1_VALUE <= 0;
      MAX2_VALUE <= 0;
      MAX1_FRE <= 0;
      MAX2_FRE <= 0;
      JUDGE_CNT <= 0;
      WRITE_CNT <= 0;
      JUDGE_FINISH <= '0';
      STATE <= S_IDLE;
      RE_0 <= (OTHERS => '0');
      IM_0 <= (OTHERS => '0');
      RE_1 <= (OTHERS => '0');
      IM_1 <= (OTHERS => '0');
      DATA_0 <= (OTHERS => '0');
      DATA_1 <= (OTHERS => '0');
    ELSE
      CASE STATE IS 
        WHEN S_IDLE =>
          MAX1_VALUE <= 0;
          MAX2_VALUE <= 0;
          MAX1_FRE <= 0;
          MAX2_FRE <= 0;
          JUDGE_CNT <= 0;
          WRITE_CNT <= 0;
          JUDGE_FINISH <= '0';
          IF FFT_M_DATA_TVALID = '1' AND FFT_M_DATA_TVALID_T = '0' THEN
            STATE <= S_READ;
          END IF;
        WHEN S_READ =>
          IF FFT_M_DATA_TVALID_T = '1' THEN
            RAM0(CONV_INTEGER(FFT_M_DATA_TUSER_T)) <= FFT_M_DATA_TDATA_T;
--            RAM1(CONV_INTEGER(FFT_M_DATA_TUSER_T)) <= FFT_M_DATA_TDATA_T;
            JUDGE_RAM(CONV_INTEGER(FFT_M_DATA_TUSER_T)) <= ABS_GEN(CONV_INTEGER(FFT_M_DATA_TDATA_T(22 DOWNTO 9))) + ABS_GEN(CONV_INTEGER(FFT_M_DATA_TDATA_T(46 DOWNTO 33)));
            IF FFT_M_DATA_TUSER_T = 1023 THEN
              STATE <= S_JUDGE1;
            END IF; 
          END IF;
        WHEN S_JUDGE1 =>
          IF JUDGE_CNT >= 511 THEN
            JUDGE_CNT <= 0;
            STATE <= S_JUDGE2;
          ELSE
            JUDGE_CNT <= JUDGE_CNT + 1;
          END IF;
          
          IF JUDGE_CNT /= 0 THEN
            IF JUDGE_RAM(JUDGE_CNT) > VALUE_LIMIT THEN
              IF JUDGE_RAM(JUDGE_CNT) >= MAX1_VALUE THEN
                MAX1_VALUE <= JUDGE_RAM(JUDGE_CNT);
                MAX2_VALUE <= MAX1_VALUE;
                MAX1_FRE <= JUDGE_CNT;
                MAX2_FRE <= MAX1_FRE;
              ELSIF JUDGE_RAM(JUDGE_CNT) >= MAX2_VALUE THEN
                MAX1_VALUE <= MAX1_VALUE;
                MAX2_VALUE <= JUDGE_RAM(JUDGE_CNT);
                MAX1_FRE <= MAX1_FRE;
                MAX2_FRE <= JUDGE_CNT;
              ELSE
                MAX1_VALUE <= MAX1_VALUE;
                MAX2_VALUE <= MAX2_VALUE;
                MAX1_FRE <= MAX1_FRE;
                MAX2_FRE <= MAX2_FRE;
              END IF;
            END IF;
          END IF;
        WHEN S_JUDGE2 =>
          IF MAX1_FRE > MAX2_FRE THEN
            AF_R <= MAX2_FRE;
            BF_R <= MAX1_FRE;
          ELSE
            AF_R <= MAX1_FRE;
            BF_R <= MAX2_FRE;
          END IF;
          STATE <= S_D0_GEN;
        WHEN S_D0_GEN =>
          DATA_0 <= RAM0(AF_R);
          STATE <= S_D1_GEN;
        WHEN S_D1_GEN =>
          DATA_1 <= RAM0(BF_R);
          STATE <= S_FINISH;
        WHEN S_FINISH => 
          JUDGE_FINISH <= '1';
          RE_0 <= CONV_STD_LOGIC_VECTOR(CONV_INTEGER(DATA_0(22 DOWNTO 9)),12);
          IM_0 <= CONV_STD_LOGIC_VECTOR(CONV_INTEGER(DATA_0(46 DOWNTO 33)),12);
          RE_1 <= CONV_STD_LOGIC_VECTOR(CONV_INTEGER(DATA_1(22 DOWNTO 9)),12);
          IM_1 <= CONV_STD_LOGIC_VECTOR(CONV_INTEGER(DATA_1(46 DOWNTO 33)),12);
          AF_OUT <= CONV_STD_LOGIC_VECTOR(AF_R,8);
          BF_OUT <= CONV_STD_LOGIC_VECTOR(BF_R,8);
          STATE <= S_IDLE;
        WHEN OTHERS => 
          STATE <= S_IDLE;
      END CASE;
    END IF;
  END PROCESS;

--  PROCESS IS BEGIN
--  WAIT UNTIL RISING_EDGE(ACLK);
--    IF STATE /= S_WRITE THEN
--      IF FFT_RAM0_ADDR = 0 THEN
--        FFT_RAM0_DATA <= (OTHERS => '0');
--      ELSIF FFT_RAM0_ADDR = AF_R THEN
--        FFT_RAM0_DATA <= RAM0(CONV_INTEGER(FFT_RAM0_ADDR));
--      ELSE
--        FFT_RAM0_DATA <= (OTHERS => '0');
--      END IF;
--    ELSE
--      FFT_RAM0_DATA <= (OTHERS => '0');
--    END IF;
--  END PROCESS;             
  
--  PROCESS IS BEGIN
--  WAIT UNTIL RISING_EDGE(ACLK);
--    IF STATE /= S_WRITE THEN
--      IF FFT_RAM1_ADDR = 0 THEN
--        FFT_RAM1_DATA <= (OTHERS => '0');
--      ELSIF FFT_RAM1_ADDR > 300 THEN
--        FFT_RAM1_DATA <= (OTHERS => '0');
--      ELSIF FFT_RAM1_ADDR /= AF_R THEN
--        FFT_RAM1_DATA <= RAM1(CONV_INTEGER(FFT_RAM1_ADDR));
--      ELSE
--        FFT_RAM1_DATA <= (OTHERS => '0');
--      END IF;
--    ELSE
--      FFT_RAM1_DATA <= (OTHERS => '0');
--    END IF;
--  END PROCESS;                    

END ARCHITECTURE;