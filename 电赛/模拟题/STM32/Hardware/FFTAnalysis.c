#include "FFTAnalysis.h"

short ADC_Value[SAMPLE_NODE_NUM] = {2048,3252,100,3996,844,2048,3252,100,3996,844,2048,3252,100,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3996
};//   long是32位
long InBufArray[SAMPLE_NODE_NUM] = {0}; // 定义输入数组
long OutBufArray[SAMPLE_NODE_NUM / 2];  // 定义输出数组
long MagBufArray[SAMPLE_NODE_NUM / 2];  // 幅值
u16 MagBufIndex[SAMPLE_NODE_NUM / 2];   // 赋值从大到小的索引
double PhaBufArray[SAMPLE_NODE_NUM / 2];

void _fswap_long(long *a, long *b)
{
    long temp = *a;
    *a = *b;
    *b = temp;
}

void _fswap_u16(u16 *a, u16 *b)
{
    u16 temp = *a;
    *a = *b;
    *b = temp;
}

void _fswap_double(double *a, double *b)
{
    double temp = *a;
    *a = *b;
    *b = temp;
}

void CalcFFT(void) // 快速FFT
{
    for (int i = 0; i < SAMPLE_NODE_NUM; i++)
    {
        InBufArray[i] = ((signed short)(ADC_Value[i]-2048)) << 16;
    }
    cr4_fft_1024_stm32(OutBufArray, InBufArray, SAMPLE_NODE_NUM);
}

void GetPowerMag(void)
{
    signed short lX, lY;
    float X, Y, Mag;
    unsigned short i;
    for (i = 0; i < SAMPLE_NODE_NUM / 2; i++)
    {
        MagBufIndex[i] = i;
        lX = (OutBufArray[i] << 16) >> 16;
        lY = (OutBufArray[i] >> 16);

        // 除以32768再乘65536是为了符合浮点数计算规律
        X = SAMPLE_NODE_NUM * ((float)lX) / 32768;
        Y = SAMPLE_NODE_NUM * ((float)lY) / 32768;
        Mag = sqrt(X * X + Y * Y) / SAMPLE_NODE_NUM;
        if (i == 0)
            MagBufArray[i] = (unsigned long)(Mag * 32768);
        else
            MagBufArray[i] = (unsigned long)(Mag * 65536); // MagBufArray[]为计算输出的幅值数组
    }
}

void GetPowerMagAndPha(void)
{
    signed short lX, lY;
    float X, Y, Mag;
    unsigned short i;
    for (i = 0; i < SAMPLE_NODE_NUM / 2; i++)
    {
        MagBufIndex[i] = i;
        lX = (OutBufArray[i] << 16) >> 16; // REAL
        lY = (OutBufArray[i] >> 16);       // IMAGE
        PhaBufArray[i] = atan2(lX, lY);
        // 除以32768再乘65536是为了符合浮点数计算规律
        X = SAMPLE_NODE_NUM * ((float)lX) / 32768;
        Y = SAMPLE_NODE_NUM * ((float)lY) / 32768;
        Mag = sqrt(X * X + Y * Y) / SAMPLE_NODE_NUM;
        if (i == 0)
            MagBufArray[i] = (unsigned long)(Mag * 32768);
        else
            MagBufArray[i] = (unsigned long)(Mag * 65536); // MagBufArray[]为计算输出的幅值数组
    }
}

void SortSpec(void)
{
    for (int i = 0; i < SAMPLE_NODE_NUM / 2; i++)
    {
        for (int j = i + 1; j < SAMPLE_NODE_NUM / 2; j++)
        {
            if (MagBufArray[i] < MagBufArray[j])
            {
                _fswap_long(&MagBufArray[i], &MagBufArray[j]);
                _fswap_double(&PhaBufArray[i], &PhaBufArray[j]);
                _fswap_u16(&MagBufIndex[i], &MagBufIndex[j]);
            }
        }
    }
}

u16 GetMaxSpec(u8 noDC)
{
    if(noDC == 1)
	{
		long mmax = 0;
		u16 index = 0;
		for (int i = 1; i < SAMPLE_NODE_NUM / 2; i++)
		{
			if (mmax < MagBufArray[i])
			{
				mmax = MagBufArray[i];
				index = i;
			}
		}
		return index;
	}
	else
	{
		long mmax = 0;
		u16 index = 0;
		for (int i = 0; i < SAMPLE_NODE_NUM / 2; i++)
		{
			if (mmax < MagBufArray[i])
			{
				mmax = MagBufArray[i];
				index = i;
			}
		}
		return index;
	}
}

double CalcTHD(u16 n)
{
    long t = 0;
    SortSpec();
    for (int i = 1; i < n; i++)
    {
        t += (MagBufArray[i] * MagBufArray[i]);
    }
    return sqrt(t) / (MagBufArray[0] * 1.0);
}
