#include "DigitalOrthDecomposition.h"


short DAC_SIN[200 * 19] =
    // 第一行是20K -> 1s 10K
    { // DAC正弦缓冲区,每行 200点。第一行有2个正弦波，第三行有4个……第19行有20个
        2142, 2236, 2329, 2421, 2512, 2600, 2687, 2771, 2852, 2930, 3004, 3075,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 2048,
        2189, 2329, 2466, 2600, 2729, 2852, 2967, 3075, 3173, 3262, 3339, 3405,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 2048,
        2236, 2421, 2600, 2771, 2930, 3075, 3204, 3314, 3405, 3475, 3521, 3545,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 2048,
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        2930, 3475, 3475, 2930, 2048, 1166, 621, 621, 1166, 2048, 2930, 3475,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 1166, 2048};
short DAC_COS[200 * 19] =
    { // DAC余弦缓冲区,每行 200点。第一行有2个正弦波，第三行有4个……第19行有20个
        3545, 3536, 3521, 3501, 3475, 3443, 3405, 3362, 3314, 3262, 3204, 3141,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 3548,
        3541, 3521, 3488, 3443, 3385, 3314, 3233, 3141, 3040, 2930, 2812, 2687,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 3548,
        3536, 3501, 3443, 3362, 3262, 3141, 3004, 2852, 2687, 2512, 2329, 2142,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 3548,
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        3262, 2512, 1584, 834, 548, 834, 1584, 2512, 3262, 3548, 3262, 2512,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 3262, 3548};


double pos_angle_0, pos_angle_1;
unsigned char fre[2];
short ADCConvertedValue2[1000] = {3022,2880,2737,2599,2468,2348,2242,2152,2080,2028,1998,1989,2001,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1824
}; // 采样点 需修改

// 计算IQ分量的模的长度
double modulus(double I, double Q)
{
    double temp_double;
    temp_double = sqrt(I * I + Q * Q);
    return temp_double;
}

void cal_2frqs(void) // 计算参与叠加的两个正弦信号的频率
{
    double corr_sin_double; // 用于存放C与所有19种正弦相关计算的结果
    double corr_cos_double; // 用于存放C与所有19种余弦相关计算的结果
    double mag[19];         // 用于存放输入信号与所有19种信号相关计算的模
    double temp_double[19], sort_temp;
    unsigned char i, j, temp_char;
    for (i = 0; i < 19; i++)
    {
        corr_sin_double = corr1000_200(CALC_SAMPLE_LIST, DAC_SIN + 200 * i);
        corr_cos_double = corr1000_200(CALC_SAMPLE_LIST, DAC_COS + 200 * i);
        mag[i] = modulus(corr_sin_double, corr_cos_double);
        temp_double[i] = mag[i];
    }
    // 冒泡法对大小进行排序
    for (i = 0; i < 19 - 1; i++)
    {
        for (j = 0; j < 19 - i - 1; j++)
        {
            if (temp_double[j] < temp_double[j + 1])
            {
                sort_temp = temp_double[j];
                temp_double[j] = temp_double[j + 1];
                temp_double[j + 1] = sort_temp;
            }
        }
    }
    // 寻找最大值序号
    for (i = 0; i < 19; i++)
    {
        if (mag[i] == temp_double[0]) // 找到最大数
            fre[0] = i;
        if (mag[i] == temp_double[1]) // 找到第二大数
            fre[1] = i;
    }
    if (fre[0] > fre[1])
    { // 把频率低的放在第一个位置，如果颠倒就换一下
        temp_char = fre[0];
        fre[0] = fre[1];
        fre[1] = temp_char;
    }
}

void get_pos_angle(void)
{
    unsigned char i = 0;
    double temp_double_sin = corr1000_200(CALC_SAMPLE_LIST, DAC_SIN + 200 * fre[0]);
    double temp_double_cos = corr1000_200(CALC_SAMPLE_LIST, DAC_COS + 200 * fre[0]);
    double temp_double_angle_0 = atan2(temp_double_cos, temp_double_sin);

    if (temp_double_angle_0 < 0) // atan2函数计算得到的相位差在-pi到pi，但当其小于0时，DAC输出的信号无法提前相位，只能将所有相位全部延迟一个周期，即进行一个周期的求补操作
        pos_angle_0 = -temp_double_angle_0;
    else
        pos_angle_0 = 2 * 3.1415926 - temp_double_angle_0;

    temp_double_sin = corr1000_200(CALC_SAMPLE_LIST, DAC_SIN + 200 * fre[1]);
    temp_double_cos = corr1000_200(CALC_SAMPLE_LIST, DAC_COS + 200 * fre[1]);
    double temp_double_angle_1 = atan2(temp_double_cos, temp_double_sin);

    if (temp_double_angle_1 < 0) // atan2函数计算得到的相位差在-pi到pi，但当其小于0时，DAC输出的信号无法提前相位，只能将所有相位全部延迟一个周期，即进行一个周期的求补操作
        pos_angle_1 = -temp_double_angle_1;
    else
        pos_angle_1 = 2 * 3.1415926 - temp_double_angle_1;
}

// 确定频率用
double corr1000_200(short *data, short *mask)
{
    double res = 0;
    short i;
    for (i = 0; i < 1000; i++)
        res = res + (data[i] - 2048) * (mask[i % 200] - 2048); // 注意SIN与COS模版要减去直流偏置，才是真正的信号
    return res;
}
